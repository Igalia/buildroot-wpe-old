## Config.in
```kconfig
# Include all package configuration snippets from the overlay.
source "$BR2_EXTERNAL_WPE_RPI_PATH/package/dyz/Config.in"
source "$BR2_EXTERNAL_WPE_RPI_PATH/package/eglinfo/Config.in"
source "$BR2_EXTERNAL_WPE_RPI_PATH/package/luajit-beta/Config.in"
source "$BR2_EXTERNAL_WPE_RPI_PATH/package/wpebackend/Config.in"
source "$BR2_EXTERNAL_WPE_RPI_PATH/package/wpebackend-fdo/Config.in"
source "$BR2_EXTERNAL_WPE_RPI_PATH/package/wpewebkit/Config.in"
```

## configs/raspberrypi2_wpe_defconfig
```kconfig
BR2_arm=y
BR2_cortex_a7=y
BR2_ARM_FPU_NEON_VFPV4=y
BR2_ARM_INSTRUCTIONS_THUMB2=y
BR2_CCACHE=y
BR2_OPTIMIZE_2=y
BR2_TOOLCHAIN_BUILDROOT_GLIBC=y
BR2_PACKAGE_HOST_LINUX_HEADERS_CUSTOM_4_4=y
BR2_TOOLCHAIN_BUILDROOT_CXX=y
BR2_TARGET_GENERIC_CABUNDLE=y
BR2_ROOTFS_DEVICE_CREATION_DYNAMIC_EUDEV=y
BR2_TARGET_GENERIC_ROOT_PASSWD="root"
BR2_TARGET_GENERIC_GETTY_PORT="tty1"
BR2_SYSTEM_DHCP="eth0"
BR2_ROOTFS_POST_IMAGE_SCRIPT="board/raspberrypi2/post-ml-image.sh"
BR2_LINUX_KERNEL=y
BR2_LINUX_KERNEL_CUSTOM_GIT=y
BR2_LINUX_KERNEL_CUSTOM_REPO_URL="https://github.com/raspberrypi/linux.git"
BR2_LINUX_KERNEL_CUSTOM_REPO_VERSION="25aa8634418934f094e13ac75c902416194d1dbd"
BR2_LINUX_KERNEL_USE_CUSTOM_CONFIG=y
BR2_LINUX_KERNEL_CUSTOM_CONFIG_FILE="board/raspberrypi2/rpi2-linux-4.4.config"
BR2_LINUX_KERNEL_DTS_SUPPORT=y
BR2_LINUX_KERNEL_INTREE_DTS_NAME="bcm2709-rpi-2-b bcm2710-rpi-3-b"
BR2_PACKAGE_BUSYBOX_SMP=y
BR2_PACKAGE_GSTREAMER1=y
BR2_PACKAGE_GSTREAMER1_GIT=y
BR2_PACKAGE_GSTREAMER1_PARSE=y
BR2_PACKAGE_GSTREAMER1_TRACE=y
BR2_PACKAGE_GSTREAMER1_GST_DEBUG=y
BR2_PACKAGE_GSTREAMER1_PLUGIN_REGISTRY=y
BR2_PACKAGE_GSTREAMER1_INSTALL_TOOLS=y
BR2_PACKAGE_GST1_COMMON=y
BR2_PACKAGE_GST1_PLUGINS_BASE=y
BR2_PACKAGE_GST1_PLUGINS_BASE_PLUGIN_APP=y
BR2_PACKAGE_GST1_PLUGINS_BASE_PLUGIN_VIDEOCONVERT=y
BR2_PACKAGE_GST1_PLUGINS_BASE_PLUGIN_GIO=y
BR2_PACKAGE_GST1_PLUGINS_BASE_PLUGIN_AUDIOCONVERT=y
BR2_PACKAGE_GST1_PLUGINS_BASE_PLUGIN_AUDIOTESTSRC=y
BR2_PACKAGE_GST1_PLUGINS_BASE_PLUGIN_PLAYBACK=y
BR2_PACKAGE_GST1_PLUGINS_BASE_PLUGIN_AUDIORESAMPLE=y
BR2_PACKAGE_GST1_PLUGINS_BASE_PLUGIN_TYPEFIND=y
BR2_PACKAGE_GST1_PLUGINS_BASE_PLUGIN_VIDEOTESTSRC=y
BR2_PACKAGE_GST1_PLUGINS_BASE_PLUGIN_VIDEOSCALE=y
BR2_PACKAGE_GST1_PLUGINS_BASE_PLUGIN_VOLUME=y
BR2_PACKAGE_GST1_PLUGINS_BASE_PLUGIN_OGG=y
BR2_PACKAGE_GST1_PLUGINS_BASE_PLUGIN_OPUS=y
BR2_PACKAGE_GST1_PLUGINS_BASE_PLUGIN_PANGO=y
BR2_PACKAGE_GST1_PLUGINS_BASE_PLUGIN_THEORA=y
BR2_PACKAGE_GST1_PLUGINS_GOOD=y
BR2_PACKAGE_GST1_PLUGINS_GOOD_PLUGIN_AVI=y
BR2_PACKAGE_GST1_PLUGINS_GOOD_PLUGIN_DEBUGUTILS=y
BR2_PACKAGE_GST1_PLUGINS_GOOD_PLUGIN_ISOMP4=y
BR2_PACKAGE_GST1_PLUGINS_GOOD_PLUGIN_MATROSKA=y
BR2_PACKAGE_GST1_PLUGINS_GOOD_PLUGIN_WAVPARSE=y
BR2_PACKAGE_GST1_PLUGINS_GOOD_PLUGIN_PULSE=y
BR2_PACKAGE_GST1_PLUGINS_GOOD_PLUGIN_VPX=y
BR2_PACKAGE_GST1_PLUGINS_GOOD_PLUGIN_AUDIOFX=y
BR2_PACKAGE_GST1_PLUGINS_GOOD_PLUGIN_AUDIOPARSERS=y
BR2_PACKAGE_GST1_PLUGINS_GOOD_PLUGIN_AUTODETECT=y
BR2_PACKAGE_GST1_PLUGINS_GOOD_PLUGIN_DEINTERLACE=y
BR2_PACKAGE_GST1_PLUGINS_GOOD_PLUGIN_INTERLEAVE=y
BR2_PACKAGE_GST1_PLUGINS_GOOD_PLUGIN_RTP=y
BR2_PACKAGE_GST1_PLUGINS_GOOD_PLUGIN_RTPMANAGER=y
BR2_PACKAGE_GST1_PLUGINS_GOOD_PLUGIN_SOUPHTTPSRC=y
BR2_PACKAGE_GST1_PLUGINS_BAD=y
BR2_PACKAGE_GST1_PLUGINS_BAD_LIB_OPENGL=y
BR2_PACKAGE_GST1_PLUGINS_BAD_HAS_LIB_OPENGL=y
BR2_PACKAGE_GST1_PLUGINS_BAD_LIB_OPENGL_HAS_API=y
BR2_PACKAGE_GST1_PLUGINS_BAD_LIB_OPENGL_GLES2=y
BR2_PACKAGE_GST1_PLUGINS_BAD_LIB_OPENGL_HAS_PLATFORM=y
BR2_PACKAGE_GST1_PLUGINS_BAD_LIB_OPENGL_EGL=y
BR2_PACKAGE_GST1_PLUGINS_BAD_LIB_OPENGL_HAS_WINDOW=y
BR2_PACKAGE_GST1_PLUGINS_BAD_LIB_OPENGL_DISPMANX=y
BR2_PACKAGE_GST1_PLUGINS_BAD_PLUGIN_DEBUGUTILS=y
BR2_PACKAGE_GST1_PLUGINS_BAD_PLUGIN_GDP=y
BR2_PACKAGE_GST1_PLUGINS_BAD_PLUGIN_GL=y
BR2_PACKAGE_GST1_PLUGINS_BAD_PLUGIN_HLS=y
BR2_PACKAGE_GST1_PLUGINS_BAD_PLUGIN_DTLS=y
BR2_PACKAGE_GST1_PLUGINS_BAD_PLUGIN_MPEGTSDEMUX=y
BR2_PACKAGE_GST1_PLUGINS_BAD_PLUGIN_VIDEOPARSERS=y
BR2_PACKAGE_GST1_PLUGINS_BAD_PLUGIN_DASH=y
BR2_PACKAGE_GST1_PLUGINS_BAD_PLUGIN_FAAD=y
BR2_PACKAGE_GST1_PLUGINS_BAD_PLUGIN_SRTP=y
BR2_PACKAGE_GST1_PLUGINS_BAD_PLUGIN_SMOOTHSTREAMING=y
BR2_PACKAGE_GST1_PLUGINS_BAD_PLUGIN_HLS=y
BR2_PACKAGE_GST1_PLUGINS_BAD_PLUGIN_SMOOTHSTREAMING=y
BR2_PACKAGE_GST1_PLUGINS_UGLY=y
BR2_PACKAGE_GST1_PLUGINS_UGLY_PLUGIN_MPG123=y
BR2_PACKAGE_GST1_RPICAMSRC=y
BR2_PACKAGE_GST1_OPENWEBRTC=y
BR2_PACKAGE_GST_OMX=y
BR2_PACKAGE_GRAPHENE=y
BR2_PACKAGE_WPE_USE_WEB_AUDIO=y
BR2_PACKAGE_WPE_USE_GSTREAMER_GL=y
BR2_PACKAGE_WPE_USE_GSTREAMER_WEBKIT_HTTP_SRC=y
BR2_PACKAGE_WPE_USE_PUNCH_HOLE_NONE=y
BR2_PACKAGE_PULSEAUDIO=y
BR2_PACKAGE_PULSEAUDIO_DAEMON=y
BR2_PACKAGE_LIBVORBIS=y
BR2_PACKAGE_OPUS=y
BR2_PACKAGE_PANGO=y
BR2_PACKAGE_LIBTHEORA=y
BR2_PACKAGE_NINJA=y
BR2_PACKAGE_BITSTREAM_VERA=y
BR2_PACKAGE_WPE_LAUNCHER=y
BR2_PACKAGE_RPI_FIRMWARE=y
BR2_PACKAGE_RPI_FIRMWARE_X=y
# BR2_PACKAGE_EUDEV_ENABLE_HWDB is not set
BR2_PACKAGE_RPI_USERLAND=y
BR2_PACKAGE_WPE=y
# BR2_PACKAGE_WPE_USE_ENCRYPTED_MEDIA_V1 is not set
BR2_PACKAGE_LIBXKBCOMMON=y
# BR2_PACKAGE_WPE_USE_GSTREAMER_GL is not set
BR2_PACKAGE_WPE_ENABLE_WEB_RTC=y
BR2_PACKAGE_JSON_GLIB=y
BR2_PACKAGE_OPENWEBRTC=y
BR2_PACKAGE_LIBPROVISION=y
BR2_PACKAGE_ORC=y
BR2_PACKAGE_SHARED_MIME_INFO=y
BR2_PACKAGE_DROPBEAR=y
BR2_PACKAGE_GESFTPSERVER=y
BR2_PACKAGE_OPENVPN=y
BR2_PACKAGE_OPENVPN_SMALL=y
BR2_PACKAGE_TCPDUMP=y
BR2_PACKAGE_SCREEN=y
```

## package/dyz/Config.in
```kconfig
config BR2_PACKAGE_DYZ
	bool "dyz"
	select BR2_PACKAGE_LUAJIT_BETA
	select BR2_PACKAGE_WESTON
	select BR2_PACKAGE_WPEBACKEND_FDO
	select BR2_PACKAGE_WPEWEBKIT
	help
	  A simple launcher for WPE WebKit
```

## package/graphene/Config.in
```kconfig
config BR2_PACKAGE_GRAPHENE
	bool "graphene"
	depends on BR2_USE_WCHAR # glib2
	depends on BR2_TOOLCHAIN_HAS_THREADS # glib2
	depends on BR2_USE_MMU # glib2
	select BR2_PACKAGE_LIBGLIB2
	help
           A thin layer of graphic data types http://ebassi.github.com/graphene

comment "graphene needs a toolchain w/ wchar, threads"
	depends on BR2_USE_MMU
	depends on !BR2_USE_WCHAR || !BR2_TOOLCHAIN_HAS_THREADS
```

## package/luajit-beta/Config.in
```kconfig
config BR2_PACKAGE_LUAJIT_BETA_ARCH_SUPPORTS
	bool
	default y if BR2_aarch64
	depends on BR2_HOSTARCH = "x86_64"

config BR2_PACKAGE_LUAJIT_BETA
	bool "luajit"
	depends on !BR2_STATIC_LIBS # dlopen
	# Luajit is only available for some target architectures, and
	# has some complexity wrt 32/64. See luajit.mk for details.
	depends on BR2_PACKAGE_LUAJIT_BETA_ARCH_SUPPORTS
	# luajit.mk uses the "-m32" compiler option to build 32bit
	# binaries, so check if that option is supported. See
	# luajit.mk for details.
	select BR2_PACKAGE_HAS_LUAINTERPRETER
	select BR2_HOSTARCH_NEEDS_IA32_COMPILER if !BR2_ARCH_IS_64
	help
	  LuaJIT implements the full set of language features defined
	  by Lua 5.1. The virtual machine (VM) is API- and
	  ABI-compatible to the standard Lua interpreter and can be
	  deployed as a drop-in replacement.

	  http://luajit.org/

if BR2_PACKAGE_LUAJIT_BETA

config BR2_PACKAGE_PROVIDES_LUAINTERPRETER
	default "luajit"

config BR2_PACKAGE_LUAINTERPRETER_ABI_VERSION
	default "5.1"

endif

comment "luajit needs a toolchain w/ dynamic library"
	depends on BR2_STATIC_LIBS
```
